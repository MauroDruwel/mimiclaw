## sdkconfig.defaults.esp32
```kconfig
# MimiClaw - ESP32-WROOM-32 Configuration
# Target: ESP32 (no PSRAM)
CONFIG_IDF_TARGET="esp32"

# Flash 4MB + DIO
CONFIG_ESPTOOLPY_FLASHSIZE_4MB=y
CONFIG_ESPTOOLPY_FLASHMODE_DIO=y

# CPU 240MHz
CONFIG_ESP_DEFAULT_CPU_FREQ_MHZ_240=y

# PSRAM - DISABLED (no PSRAM on WROOM-32)
CONFIG_SPIRAM=n

# WiFi memory optimization
CONFIG_ESP_WIFI_STATIC_RX_BUFFER_NUM=2
CONFIG_ESP_WIFI_DYNAMIC_RX_BUFFER_NUM=4
CONFIG_ESP_WIFI_RX_BA_WIN=2
CONFIG_LWIP_TCPIP_RECVMBOX_SIZE=12

# TLS optimization (smaller buffers for no-PSRAM)
CONFIG_MBEDTLS_SSL_IN_CONTENT_LEN=8192
CONFIG_MBEDTLS_SSL_OUT_CONTENT_LEN=4096

# WebSocket support (must be explicitly enabled on ESP32)
CONFIG_HTTPD_WS_SUPPORT=y

# Custom partition table
CONFIG_PARTITION_TABLE_CUSTOM=y
CONFIG_PARTITION_TABLE_CUSTOM_FILENAME="partitions_esp32.csv"

# UART console
CONFIG_ESP_CONSOLE_UART_DEFAULT=y
CONFIG_ESP_CONSOLE_UART_NUM=0
CONFIG_ESP_CONSOLE_UART_BAUDRATE=115200
```
